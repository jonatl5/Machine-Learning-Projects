#include <TensorFlowLite.h>
#include "network_model.h"
#include "tensorflow/lite/micro/kernels/micro_ops.h"
#include "tensorflow/lite/micro/micro_error_reporter.h"
#include "tensorflow/lite/micro/micro_interpreter.h"
#include "tensorflow/lite/micro/micro_mutable_op_resolver.h"
#include "tensorflow/lite/schema/schema_generated.h"
#include "tensorflow/lite/version.h"

#define NUMBER_OF_INPUTS 38
#define NUMBER_OF_OUTPUTS 2
#define NUMBER_OF_SAMPLES 15
#define TENSOR_ARENA_SIZE (16 * 1024)

uint8_t tensor_arena[TENSOR_ARENA_SIZE];
tflite::ErrorReporter* error_reporter;
tflite::MicroInterpreter* interpreter;
TfLiteTensor* input;
TfLiteTensor* output;

// Label mapping from the Python notebook: attack = 0, normal = 1.
// Samples 1-5 answer part 5(c); samples 6-15 answer part 5(d).
const unsigned int X_test_dim1 = 15;
const unsigned int X_test_dim2 = 38;

const float X_test[15][38] = {
    -0.11024922, -2.4687243, -0.99266285, 0.75111127, -0.0075864405, 
    -0.0049186447, -0.08948642, -0.095075674, -0.8092618, -0.011663643, 
    -0.036651872, -0.024436507, -0.01238515, -0.026180025, -0.018609896, 
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    -0.54960024, -0.6024325, -0.38763463, -0.37638703, -0.65636677
};


const unsigned int y_test_dim1 = 15;

const uint8_t y_test[15] = {
    0, 1, 1, 0, 0, 0, 1, 0, 1, 0, 0, 0, 1, 0, 1
};


float ReadOutputScore(int index) {
    if (output->type == kTfLiteFloat32) {
        return output->data.f[index];
    }
    if (output->type == kTfLiteInt8) {
        return (output->data.int8[index] - output->params.zero_point) * output->params.scale;
    }
    if (output->type == kTfLiteUInt8) {
        return (output->data.uint8[index] - output->params.zero_point) * output->params.scale;
    }
    return 0.0f;
}

void setup() {
    Serial.begin(115200);
    while (!Serial) {}

    static tflite::MicroErrorReporter micro_error_reporter;
    error_reporter = &micro_error_reporter;

    const tflite::Model* model = tflite::GetModel(network_model);
    if (model->version() != TFLITE_SCHEMA_VERSION) {
        Serial.println("Model version does not match schema version.");
        return;
    }

    static tflite::MicroMutableOpResolver<10> micro_op_resolver;
    micro_op_resolver.AddFullyConnected();
    micro_op_resolver.AddSoftmax();
    micro_op_resolver.AddQuantize();
    micro_op_resolver.AddDequantize();
    micro_op_resolver.AddReshape();

    static tflite::MicroInterpreter static_interpreter(
        model,
        micro_op_resolver,
        tensor_arena,
        TENSOR_ARENA_SIZE,
        error_reporter);
    interpreter = &static_interpreter;

    if (interpreter->AllocateTensors() != kTfLiteOk) {
        Serial.println("Failed to allocate tensors!");
        return;
    }

    input = interpreter->input(0);
    output = interpreter->output(0);

    Serial.println("Network anomaly inference started.");
}

void loop() {
    for (uint8_t i = 0; i < NUMBER_OF_SAMPLES; i++) {
        for (int j = 0; j < NUMBER_OF_INPUTS; j++) {
            input->data.f[j] = X_test[i][j];
        }

        if (interpreter->Invoke() != kTfLiteOk) {
            Serial.println("Failed to invoke!");
            continue;
        }

        float attack_score = ReadOutputScore(0);
        float normal_score = ReadOutputScore(1);
        int predicted_class = (normal_score > attack_score) ? 1 : 0;

        Serial.print("Sample #");
        Serial.print(i + 1);
        Serial.print(", Predicted Class: ");
        Serial.print(predicted_class);
        Serial.print(", Actual Class: ");
        Serial.println(y_test[i]);

        delay(1000);
    }

    delay(10000);
}
